VERSION ""

NS_ :

BS_:

BU_: msg1

BO_ 1 msg1: 8 msg1
 SG_ New_Signal : 0|8@1+ (1,0) [0|8] "" Vector__XXX
